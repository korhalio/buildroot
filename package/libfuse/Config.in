## package/libfuse/Config.in
```kconfig
config BR2_PACKAGE_LIBFUSE
	bool "libfuse"
	# Really doesn't like static, see fuse/lib/fuse.c
	depends on BR2_TOOLCHAIN_HAS_THREADS
	depends on BR2_USE_MMU # fork()
	help
	  FUSE (Filesystem in UserSpacE)

	  https://github.com/libfuse/libfuse
```
